// Copyright (C) Microsoft Corporation. All rights reserved.

// --------------------------------------------------------------------
// Setup Paths
// --------------------------------------------------------------------
&CUR_DIR=Os.PresentPracticeDirectory()
&REPO_PATH_AP_BAREMETAL_ELF = OS.ENV(REPO_APP_PATH_kingsgate.ap.baremetal)
&REPO_PATH_AP_SDM_CDED_ELF = OS.ENV(REPO_APP_PATH_kingsgate.sdm.cded)
&REPO_PATH_KINGSGATE_FW_SCRIPTS = OS.ENV(REPO_APP_PATH_kingsgate.fw.scripts)
&REPO_ROOT_DIR = OS.ENV(REPO_APP_ROOT)
&REPO_APP_BUILD_DIR = OS.ENV(REPO_APP_BUILD_DIR)
&REPO_APP_BUILD_CONFIG = OS.ENV(REPO_APP_BUILD_CONFIG)

&RUN_DIR="&REPO_PATH_KINGSGATE_FW_SCRIPTS"

// These paths point to example source directories (for debug)
&SCP_FW_SOURCE_DIR="&REPO_ROOT_DIR"
&MCP_FW_SOURCE_DIR="&REPO_ROOT_DIR"
&SDM_FW_SOURCE_DIR="R:\Users\prodfw_debug\Kingsgate.SDM.CDED"
&CDED_FW_SOURCE_DIR="R:\Users\prodfw_debug\Kingsgate.SDM.CDED"
&AP_FW_SOURCE_DIR="R:\Users\prodfw_debug\Kingsgate.AP.Baremetal"

// These paths point to the baseline elfs included in the repo for testing. 
&SCP_ELF_LOC="&REPO_APP_BUILD_DIR\&REPO_APP_BUILD_CONFIG\arm-eabi-aarch\bin\scp\scp_fw.elf"
&MCP_ELF_LOC="&REPO_APP_BUILD_DIR\&REPO_APP_BUILD_CONFIG\arm-eabi-aarch\bin\mcp\mcp_fw.elf"
&SDM_ELF_LOC="&REPO_PATH_AP_SDM_CDED_ELF\build\bin\arm-eabi-aarch\Debug\sdm\sdm_fw.elf"
&CDED_ELF_LOC="&REPO_PATH_AP_SDM_CDED_ELF\build\bin\arm-eabi-aarch\Debug\cded\cded_fw.elf"
&AP_ELF_LOC="&REPO_PATH_AP_BAREMETAL_ELF\build\bin\arm-aarch64-none\Debug\ap_test.elf"

// Update FPGA Version here
&FPGA_REV="R22"

// --------------------------------------------------------------------
// Setup Script Execution Options
// --------------------------------------------------------------------
// Sideload scp FW: '1' = hijack SCP as soon as reset is released and sideload test firmware
&SIDELOAD_SCP_FW = 0.

// Setting to sideload Accelerator (SDM/CDED) firmware: '1' = Sideload enabled.
// This is only applicable if SIDELOAD_SCP_FW is set to 1.
&SIDELOAD_ACCEL_PROD_FW = 1.

// Setting to sideload AP firmware: '1' = Sideload enabled
&SIDELOAD_AP_TEST_FIRMWARE = 1.

// --------------------------------------------------------------------
// Launch HSPInitFPGA
// --------------------------------------------------------------------
PRINT "Run this on HSP Trace32 . . ."
CD.DO &RUN_DIR/HSPInitFPGA.cmm