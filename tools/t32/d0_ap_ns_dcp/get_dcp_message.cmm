//
// Copyright (c) Microsoft Corporation. All rights reserved.
//

// 
// @brief: Read the DCP Message from memory. Printing the DCP Header information
//         and returning the address of the message payload.
//
//
// @note: Assumes that there is a message in the MCP -> AP payload location in DDR. 
//
// @return: The starting address of the dcp message payload on success, returns 
//          -1 if the DCP header indicates an error.
//

//
// Grab the address of the dcp header in the message payload
//

//
// This address is determined by the DDR region mapped for ICC via MHU Payloads, with this
// specific address being a sub-range of the total region. Use `icc_mhu props` from the MCP
// CLI to see the AP Payload regions. The AP Recv payload is the MCP's Send Payload.
//
// See the total DDR region here: https://dev.azure.com/ms-tsd/Kingsgate/_git/silibs?path=/soc_fw_shared/include/memory_map/ddrss_reserved_regions.h
// See the breakdown of that region here (includes sizes): https://dev.azure.com/ms-tsd/Kingsgate/_git/silibs?path=/soc_fw_shared/include/memory_map/mscp_uefi_shared_ddrss.h
// See MCP ICC MHU CLI here: https://azurecsi.visualstudio.com/Woodinville/_git/Kingsgate.MSCP?path=/src/libs/icc_cli/src/icc_mhu_cli.c
//
&recv_payload_addr = 0x20128000C00

//
// The payload is: (Total ICC Header) + (DCP Header) + (DCP Payload)
//
// The ICC Header is 16 bytes
// See the MHU Packet details: https://dev.azure.com/ms-tsd/Kingsgate/_git/silibs?path=/libraries/icc_mhu/include/icc_mhu.h
//

// Offset past the ICC Header
&dcp_header_addr = &recv_payload_addr+0x10

//
// Read the DCP Header
//
// Thea DCP Header is 10 bytes
// See: https://microsoft.sharepoint.com/:w:/r/teams/EchoFalls/Shared%20Documents/Kingsgate%20SOC/Firmware/Telemetry/Data_Collection_Protocol/Data_Collection_Protocol_Specification_v1_0_4.docx?d=w3985a77534024f39b41ce6a7e2eca7e9&csf=1&web=1&e=TYg06V
//
&client_id_offset= 0x0
&message_id_offset= 0x2
&seq_num_offset= 0x4
&message_status_offset= 0x6
&payload_size_offset= 0x8

print  ""
print  "Getting DCP Message."
print  ""

&message_status= data.short(EOAXI:&dcp_header_addr+&message_status_offset)

// Print the DCP Header information
print ""
print "DCP Message Header Addr [0x"+format.hex(8.,&dcp_header_addr)+"]"
print "" 
print "    Client ID      [0x"+format.hex(4.,data.short(EOAXI:&dcp_header_addr+&client_id_offset))+"]"
print "    Message ID     [0x"+format.hex(4.,data.short(EOAXI:&dcp_header_addr+&message_id_offset))+"]"
print "    Sequence Num   [0x"+format.hex(4.,data.short(EOAXI:&dcp_header_addr+&seq_num_offset))+"]"
print "    Message Status [0x"+format.hex(4.,data.short(EOAXI:&dcp_header_addr+&message_status_offset))+"]"
print "    Payload Size   [0x"+format.hex(4.,data.short(EOAXI:&dcp_header_addr+&payload_size_offset))+"]"
print ""

//
// Print the Human Readable DCP Message Status
//
if (&message_status==0x0000)
(
    print "        Message Status [DATA_COLLECTION_SUCCESS] (0x0000)"
)
else if (&message_status==0x0001)
(
    print "        Message Status [DATA_COLLECTION_RD_DATA_NONE] (0x0001)"
)
else if (&message_status==0x0002)
(
    print "        Message Status [DATA_COLLECTION_RD_DATA_VALID_LAST] (0x0002)"
)
else if (&message_status==0x0003)
(
    print "        Message Status [DATA_COLLECTION_RD_DATA_VALID_MORE] (0x0003)"
)
else if (&message_status==0xFFFF)
(
    print "        Message Status [DATA_COLLECTION_E_SIZE] (0xFFFF)"
)
else if (&message_status==0xFFFE)
(
    print "        Message Status [DATA_COLLECTION_E_PARAM] (0xFFFE)"
)
else if (&message_status==0xFFFD)
(
    print "        Message Status [DATA_COLLECTION_E_BUSY] (0xFFFD)"
)
else if (&message_status==0xFFFC)
(
    print "        Message Status [DATA_COLLECTION_E_UNK_MSG] (0xFFFC)"
)
else if (&message_status==0xFFFB)
(
    print "        Message Status [DATA_COLLECTION_E_UNK_CLIENT] (0xFFFB)"
)
else if (&message_status==0xFFFA)
(
    print "        Message Status [DATA_COLLECTION_E_INCOMPLETE_HANDLER] (0xFFFA)"
)
else if (&message_status==0xFFF9)
(
    print "        Message Status [DATA_COLLECTION_E_DEPRECATED_MSG] (0xFFF9)"
)
else if (&message_status==0xFFF8)
(
    print "        Message Status [DATA_COLLECTION_E_BUFFER_DISCARDED] (0xFFF8)"
)
else if (&message_status==0xFFF7)
(
    print "        Message Status [DATA_COLLECTION_E_UNSUPPORTED_MSG] (0xFFF7)"
)
else
(
    print "        Message Status [UNKNOWN] (0x"+format.hex(4.,&message_status)+")"
)

&last_success_status= 0x0003
if (&message_status>&last_success_status)
(
    print  ""
    print  %COLOR.RED "ERROR"
    print  %COLOR.RED "DCP Header contains error status!"
    print  %COLOR.RED "ERROR"
    print  ""
    ENDDO -1
)

//
// Return the DCP Message Payload address
//

&dcp_payload_addr = &dcp_header_addr+0xA

ENDDO &dcp_payload_addr