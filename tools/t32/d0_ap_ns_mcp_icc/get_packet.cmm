//
// Copyright (c) Microsoft Corporation. All rights reserved.
//

// 
// @brief: Dump the contents of the recv payload to a file.
//
//
// @return: Filename of saved payload, -1 on failure.
//

&debug= 0

// Get the status of the recv channel mailbox, don't bother getting the payload if not pending.
DO check_packet_pending.cmm recv

// Using ENTRY after calling another script will use the output of the script as the input
ENTRY &pending_status

if (&pending_status!=1)
(
    print  ""
    print  %COLOR.RED "ERROR"
    print  %COLOR.RED "No pending message, nothing new to get!"
    print  %COLOR.RED "ERROR"
    print  ""
    ENDDO -1
)

//
// This address is determined by the DDR region mapped for ICC via MHU Payloads, with this
// specific address being a sub-range of the total region. Use `icc_mhu props` from the MCP
// CLI to see the AP Payload regions. The AP Recv payload is the MCP's Send Payload.
//
// See the total DDR region here: https://dev.azure.com/ms-tsd/Kingsgate/_git/silibs?path=/soc_fw_shared/include/memory_map/ddrss_reserved_regions.h
// See the breakdown of that region here (includes sizes): https://dev.azure.com/ms-tsd/Kingsgate/_git/silibs?path=/soc_fw_shared/include/memory_map/mscp_uefi_shared_ddrss.h
// See MCP ICC MHU CLI here: https://azurecsi.visualstudio.com/Woodinville/_git/Kingsgate.MSCP?path=/src/libs/icc_cli/src/icc_mhu_cli.c
//
&recv_payload_size = 0x200
&recv_payload_addr = 0x20128000C00

// Grab the MHU Packet details: https://dev.azure.com/ms-tsd/Kingsgate/_git/silibs?path=/libraries/icc_mhu/include/icc_mhu.h
&version_offset= 0x0
&token_offset= 0x4
&id_offset= 0x6
&command_offset= 0x8
&payload_size_offset= 0xC
&status_offset= 0xE

// Useful if we want to save just the payload and not the ICC + Message Header. TBD
&payload_offset=0x10

if (&debug==1)
(
    print  ""
    print  "Getting ICC Packet."
    print  ""

    print ""
    print "ICC RECV Payload Addr [0x"+format.hex(8.,&recv_payload_addr)+"]"
    print ""
    print "    Version [0x"+format.hex(8.,data.long(ENAXI:&recv_payload_addr+&version_offset))+"]"
    print "    Token   [0x"+format.hex(4.,data.word(ENAXI:&recv_payload_addr+&token_offset))+"]"
    print "    Id      [0x"+format.hex(4.,data.word(ENAXI:&recv_payload_addr+&id_offset))+"]"
    print "    Command [0x"+format.hex(8.,data.long(ENAXI:&recv_payload_addr+&command_offset))+"]"
    print "    Size    [0x"+format.hex(4.,data.word(ENAXI:&recv_payload_addr+&payload_size_offset))+"]"
    print "    STATUS  [0x"+format.hex(4.,data.word(ENAXI:&recv_payload_addr+&status_offset))+"]"
    print ""
)

// Save the entire payload to a file. Includes ICC MHU Header + Message Header + User Payload
&time=DATE.TIME()
&d=DATE.DAY()
&m=DATE.MONTH()
&y=DATE.YEAR()
&d=STRing.Replace("&d",".","",0)
&m=STRing.Replace("&m",".","",0)
&y=STRing.Replace("&y",".","",0)
&time=STRing.Replace("&time",":","_",0)
&file_name = "d0_ap_ns_recv_payload_"+"&d"+"_"+"&m"+"_"+"&y"+"_"+"&time"+".bin"

&payload_end_addr= &recv_payload_addr+&recv_payload_size

//
// This is inclusive, so subtract one from the end address.
//
Data.SAVE.Binary &file_name ENAXI:&recv_payload_addr--(&payload_end_addr-1)

Data.Dump ENAXI:&recv_payload_addr

if (&debug==1)
(
    print ""
    print "Saved payload to "+"&file_name"
    print ""
)

//
// !!! If reproducing these scripts in firmware or software issue a Data Synchronization Barrier before writing to the MHU IP !!!
//

//
// Clear the pending status on the mailbox
//

//
// Recv Frame - https://kingsgatedocs.azurewebsites.net/static/csrs/v1.6.0/ap_addr_map/html/D0_MCP2AP_MHU_REC_NS.html
//
// Channels start after the control block in the MHU IP.
//
// Channel 0 Clear Register
// https://kingsgatedocs.azurewebsites.net/static/csrs/v1.6.0/ap_addr_map/html/D0_MCP2AP_MHU_REC_NS-MDBCW_page_Registers.html#MDBCW0_CLR
//
&mhu_address= 0x00002AA10000
&channels_offset=0x1000
&clear_reg_offset=0x8
&ch_0_flag_0_clr_address=&mhu_address+&channels_offset+&clear_reg_offset

data.set (ENAXI:&ch_0_flag_0_clr_address) %long 0x1

// Validate the pending flag is now 0
DO ./check_packet_pending.cmm recv
ENTRY &pending_status

if (&pending_status!=0)
(
    print  ""
    print  %COLOR.RED "ERROR"
    print  %COLOR.RED "Failed to clear pending bit!"
    print  %COLOR.RED "ERROR"
    print  ""
    ENDDO -1
)

ENDDO &file_name